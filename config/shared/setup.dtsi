// urob helpers
#include <zmk-helpers/helper.h>

#define QUICK_TAP_MS 150

/**
 * Home row mods
 */

#define MAKE_HRM(NAME, HOLD, TAP, TRIGGER_POS) \
    ZMK_HOLD_TAP(NAME, \
        flavor = "balanced"; \
        tapping-term-ms = <300>; \
        quick-tap-ms = <QUICK_TAP_MS>; \
        require-prior-idle-ms = <200>; \
        bindings = <HOLD>, <TAP>; \
        hold-trigger-key-positions = <TRIGGER_POS>; \
        hold-trigger-on-release; \
    )
    
MAKE_HRM(hml, &kp, &kp, KEYS_R THUMBS)  // left-hand HRMs
MAKE_HRM(hmr, &kp, &kp, KEYS_L THUMBS)  // right-hand HRMs

/**
 *  8 arg Combo hack
 */
#define ZMK_COMBO_8(NAME, TAP, KEYPOS, LAYERS, COMBO_TERM, COMBO_IDLE, HOLD, SIDE) \
    MAKE_HRM(hm_combo_ ## NAME, &kp, TAP, SIDE THUMBS) \
    ZMK_COMBO_6(NAME, &hm_combo_ ## NAME HOLD 0, KEYPOS, LAYERS, COMBO_TERM, COMBO_IDLE)

&sk {
    quick-release;   // no double capitalization when rolling keys
};

&lt {
    flavor = "hold-preferred";
    // not sure on that one yet..
    //retro-tap;
};

// reusable arrow keys ← ↓ ↑ →
#define ARROWS  &kp LEFT &kp DOWN &kp UP &kp RIGHT

// space move cluster
#define FOCUS &kp LC(H) &kp LC(J) &kp LC(K) &kp LC(L)

// tab change
#define TABS &kp LC(LBKT) &kp LC(RBKT)