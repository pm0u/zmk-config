// Default 600
#define ZMK_POINTING_DEFAULT_MOVE_VAL 4000
// Default 10
#define ZMK_POINTING_DEFAULT_SCRL_VAL 30

#include <dt-bindings/zmk/pointing.h>

// 1 = natural scroll in OS. 0 = no
#define NATURAL_SCROLL 1

#if IS_ENABLED(NATURAL_SCROLL)
  #define SCRLUP SCRL_DOWN
  #define SCRLDN SCRL_UP
#else
  #define SCRLUP SCRL_UP
  #define SCRLDN SCRL_DOWN
#endif

&mmv {
  acceleration-exponent = <2>;
  time-to-max-speed-ms = <600>;
  delay-ms = <0>;
  trigger-period-ms = <12>;
};

&msc {
  acceleration-exponent = <2>;
  time-to-max-speed-ms = <700>;
  delay-ms = <0>;
  trigger-period-ms = <12>;
};
