// Custom labels so that homerow and bottom line up with corne
#include "key-labels/lily58.h"
#include "shared/helpers.h"

/*               58 KEY MATRIX / LAYOUT MAPPING

 ╭─────────────────────────────┬─────────────────────────────╮
 │ LU5 LU4 LU3 LU2 LU1 LU0     │     RU0 RU1 RU2 RU3 RU4 RU5 │
 │ LT5 LT4 LT3 LT2 LT1 LT0     │     RT0 RT1 RT2 RT3 RT4 RT5 │
 │ LM5 LM4 LM3 LM2 LM1 LM0     │     RM0 RM1 RM2 RM3 RM4 RM5 │
 │ LB5 LB4 LB3 LB2 LB1 LB0 LEC │ REC RB0 RB1 RB2 RB3 RB4 RB5 │
 ╰───────────╮ LH3 LH2 LH1 LH0 │ RH0 RH1 RH2 RH3 ╭───────────╯
             ╰─────────────────┴─────────────────╯             */

#define KEYS_L LU0 LU1 LU3 LU4 LU5 LT0 LT1 LT3 LT4 LT5 LM0 LM1 LM2 LM3 LM4 LM5 LB0 LB1 LB2 LB3 LB4 LB5 LEC
#define KEYS_R RU0 RU1 RU2 RU3 RU4 RU5 RT0 RT1 RT3 RT4 RT5 RM0 RM1 RM2 RM3 RM4 RM5 RB0 RB1 RB2 RB3 RB4 RB5 REC
#define THUMBS LH0 LH1 LH2 LH3 RH0 RH1 RH2 RH3


#define X_LT ___ ___ ___ ___ ___ ___ ___ ___ ___ ___ ___ ___ \
             ___
#define X_RT ___
#define X_LM ___
#define X_RM ___
#define X_LB ___
#define X_MB ___ ___
#define X_RB ___
#define X_LH ___
#define X_RH ___


#include "base.keymap"