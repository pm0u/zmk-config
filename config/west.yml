## config/west.yml
```yaml
manifest:
  remotes:
    - name: zmkfirmware
      url-base: https://github.com/zmkfirmware
    - name: urob
      url-base: https://github.com/urob
    - name: pm0u
      url-base: https://github.com/pm0u
    - name: petejohanson
      url-base: https://github.com/petejohanson
  projects:
    - name: zmk
      remote: zmkfirmware
      revision: main
      import: app/west.yml
    - name: zmk-helpers
      remote: urob
      revision: main
    - name: glidepoint_i2c_split
      remote: pm0u
      revision: main
    - name: glidepoint_i2c_split_peripheral
      remote: pm0u
      revision: main
    - name: glidepoint_i2c_split_central
      remote: pm0u
      revision: main
    - name: cirque-input-module
      remote: petejohanson
      revision: main
  self:
    path: config
```
